## br2-external/Config.in
```kconfig
source "$BR2_EXTERNAL_LLAMASTE_PATH/package/llamaste/Config.in"
source "$BR2_EXTERNAL_LLAMASTE_PATH/package/llama-server/Config.in"
source "$BR2_EXTERNAL_LLAMASTE_PATH/package/whisper-cpp/Config.in"
```

## br2-external/package/espeak-ng/Config.in
```kconfig
config BR2_PACKAGE_ESPEAK_NG
	bool "espeak-ng"
	depends on BR2_TOOLCHAIN_HAS_THREADS
	help
	  eSpeak NG is an open source speech synthesizer that supports
	  more than hundred languages and accents. It uses formant
	  synthesis, producing clear speech at 22kHz sample rate.

	  https://github.com/espeak-ng/espeak-ng
```

## br2-external/package/labwc/Config.in
```kconfig
config BR2_PACKAGE_LABWC
	bool "labwc"
	depends on BR2_PACKAGE_HAS_LIBEGL
	depends on BR2_PACKAGE_HAS_LIBEGL_WAYLAND
	depends on BR2_PACKAGE_HAS_LIBGLES
	depends on BR2_PACKAGE_HAS_UDEV
	depends on !BR2_STATIC_LIBS
	depends on BR2_TOOLCHAIN_HAS_THREADS
	depends on BR2_USE_WCHAR
	depends on BR2_USE_MMU
	select BR2_PACKAGE_WLROOTS
	select BR2_PACKAGE_CAIRO
	select BR2_PACKAGE_CAIRO_PNG
	select BR2_PACKAGE_PANGO
	select BR2_PACKAGE_LIBGLIB2
	select BR2_PACKAGE_LIBXML2
	select BR2_PACKAGE_LIBDRM
	select BR2_PACKAGE_LIBPNG
	select BR2_PACKAGE_LIBINPUT
	select BR2_PACKAGE_LIBXKBCOMMON
	select BR2_PACKAGE_WAYLAND_PROTOCOLS
	select BR2_PACKAGE_XKEYBOARD_CONFIG  # runtime
	help
	  labwc is a wlroots-based stacking Wayland compositor.
	  It aims to be simple and fast, with a sane default
	  configuration. Uses an openbox-compatible XML config.

	  https://github.com/labwc/labwc

comment "labwc needs udev, EGL with Wayland, and OpenGL ES"
	depends on !BR2_PACKAGE_HAS_UDEV || \
		!BR2_PACKAGE_HAS_LIBEGL || \
		!BR2_PACKAGE_HAS_LIBEGL_WAYLAND || \
		!BR2_PACKAGE_HAS_LIBGLES
```

## br2-external/package/llama-server/Config.in
```kconfig
config BR2_PACKAGE_LLAMA_SERVER
	bool "llama-server"
	help
	  llama.cpp inference server. Provides OpenAI-compatible
	  HTTP API for LLM inference with GGUF models.
	  https://github.com/ggerganov/llama.cpp
```

## br2-external/package/llamaste/Config.in
```kconfig
config BR2_PACKAGE_LLAMASTE
	bool "llamaste"
	select BR2_PACKAGE_HOST_CMAKE
	select BR2_PACKAGE_ALSA_LIB
	select BR2_PACKAGE_WHISPER_CPP
	help
	  Llamaste LLM-OS. Single static C++ binary that runs as PID 1.
	  Combines llama-server + agent + system tools + web UI.

	  https://github.com/user/llamaste
```

## br2-external/package/onnxruntime/Config.in
```kconfig
config BR2_PACKAGE_ONNXRUNTIME
	bool "onnxruntime"
	depends on BR2_INSTALL_LIBSTDCPP
	depends on BR2_TOOLCHAIN_HAS_THREADS
	depends on BR2_PACKAGE_HOST_PROTOBUF_ARCH_SUPPORTS
	help
	  ONNX Runtime — cross-platform inference and training accelerator.
	  Built from source for musl libc compatibility (CPU only).

	  https://github.com/microsoft/onnxruntime
```

## br2-external/package/sherpa-onnx/Config.in
```kconfig
config BR2_PACKAGE_SHERPA_ONNX
	bool "sherpa-onnx"
	depends on BR2_INSTALL_LIBSTDCPP
	depends on BR2_TOOLCHAIN_HAS_THREADS
	help
	  sherpa-onnx — Speech-to-text, text-to-speech, and more using
	  next-gen Kaldi with onnxruntime. Provides C API for offline TTS
	  using Piper VITS models.

	  https://github.com/k2-fsa/sherpa-onnx
```

## br2-external/package/whisper-cpp/Config.in
```kconfig
config BR2_PACKAGE_WHISPER_CPP
	bool "whisper-cpp"
	help
	  whisper.cpp — C/C++ port of OpenAI's Whisper speech
	  recognition model. Provides static library (libwhisper.a)
	  for linking into the llamaste binary.
	  https://github.com/ggml-org/whisper.cpp
```
